## components/coap/Kconfig
```kconfig
menu "COAP"

config ENABLE_COAP
    bool "Enable coap"
    default n
    help
        Enable this option and coap is to be used, IPv6 is to be Enable.
endmenu
```
